## packages/citronics-initramfs/Config.in
```kconfig
config BR2_PACKAGE_CITRONICS_INITRAMFS
	bool "citronics-initramfs [FP2]"
	depends on !BR2_STATIC_LIBS
	depends on BR2_USE_MMU
	depends on BR2_TOOLCHAIN_HAS_THREADS
	select BR2_PACKAGE_BUSYBOX
	select BR2_PACKAGE_UNUDHCPD
	select BR2_PACKAGE_MULTIPATH_TOOLS
	select BR2_PACKAGE_PARTED
	select BR2_PACKAGE_E2FSPROGS
	select BR2_PACKAGE_UTIL_LINUX_BINARIES
	help
	  Builds the Citronics recovery initramfs from source and bakes in
	  the kernel-version-matched module set, the helper binaries it
	  needs (kpartx / parted / unudhcpd) with their shared-library
	  closure, and the Adreno GPU firmware.

	  The initramfs reads rootfs= / bootpart= from the kernel command
	  line (extlinux.conf), kpartx-maps the userdata partition into its
	  subpartitions, mounts the rootfs read-only and switch_roots into
	  it. Replaces the old prebuilt citros-initramfs download.
```

## packages/fp2-firmware/Config.in
```kconfig
config BR2_PACKAGE_FP2_FIRMWARE
        bool "Fairphone 2 Firmware [FP2]"
        help
          Proprietary firmware blobs for the Fairphone 2: modem (MPSS),
          ADSP, WCNSS Wi-Fi/BT, Venus, plus the ADSP sensor registry
          (qcom/sensors/sns.reg) for the in-kernel qcom_sns_reg driver.
```

## packages/hexagonrpc/Config.in
```kconfig
config BR2_PACKAGE_HEXAGONRPC
	bool "hexagonrpc [Qualcomm generic]"
	help
	  Hexagon FastRPC userspace implementation providing hexagonrpcd
	  (reverse tunnel daemon for DSP file/memory serving), chrecd
	  (Context Hub Runtime Environment client), and libhexagonrpc.

	  On the Fairphone 2 the ADSP runs the sensor firmware; hexagonrpcd
	  serves it the DSP shell + libraries over /dev/fastrpc-adsp at boot
	  so its sensor PD can come up. Needs kernel CONFIG_FASTRPC.

	  https://github.com/linux-msm/hexagonrpc
```

## packages/qrtr/Config.in
```kconfig
config BR2_PACKAGE_QRTR
        bool "qrtr [Qualcomm generic]"
        help
          Userspace reference for net/qrtr (the Qualcomm IPC Router) in
          the Linux kernel. Provides libqrtr, which rmtfs and tqftpserv
          link against.
```

## packages/rmtfs/Config.in
```kconfig
config BR2_PACKAGE_RMTFS
        bool "rmtfs [Qualcomm generic]"
	depends on BR2_PACKAGE_QRTR
        help
          Qualcomm Remote Filesystem Service. Backs the modem / ADSP EFS
          to a file in the Linux rootfs over QRTR.
```

## packages/unudhcpd/Config.in
```kconfig
config BR2_PACKAGE_UNUDHCPD
	bool "unudhcpd [Generic]"
	help
	  Single-IP DHCP server, used by the citronics initramfs to
	  hand the connected USB host an IP during recovery.
```
